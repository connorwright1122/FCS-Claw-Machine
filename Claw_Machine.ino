/*
Code for Claw Machine 
By Jackson McGill and Alissa Gaddis
*/

// Import Libraries
#include <Servo.h>
#include <Wire.h> 
#include <LiquidCrystal_I2C.h>
#include "A4988.h"

// Using 200 Steps for NEMA 17 Steppers
#define MOTOR_STEPS 200
#define MICROSTEPS 16
#define STEPS 1
#define RPM 140

// Stepper 1 (Z)
#define S1DIR   37
#define S1STEP  35
#define S1SLEEP 33
#define S1MS1   32 //white corner
#define S1MS2   34
#define S1MS3   36

// Stepper 2 (X)
#define S2DIR   43
#define S2STEP  41
#define S2SLEEP 39
#define S2MS1   38 //white
#define S2MS2   40
#define S2MS3   42

// Stepper 3 and 4 (Y)
#define S34DIR   49
#define S34STEP  47
#define S34SLEEP 45
#define S34MS1   44 //white
#define S34MS2   46
#define S34MS3   48

// LCD Display
//5V, GND pins  (5v Green, Blue Ground on ours)
//A4, A5 analog pins on Uno   20, 21 on Mega2560 -- (20 is yellow, 21 is orange on ours)

// Joystick
#define JSUP    51 //blue/orange
#define JSDOWN  53 //white
#define JSRIGHT 50  //yellow
#define JSLEFT  52 //green

// Servo for Claw
#define clawPin 22
Servo claw;
#define Opened 40
#define Closed 66
#define buttonPin 29
boolean doWork = false;
boolean bounce = false;

// Limit Switches
#define LMT1PIN 25 //X axis
#define LMT2PIN 26 //X axis
#define LMT3PIN 27 //Z axis
#define LMT4PIN 28 //Z axis

// Buttons
#define BTN1PIN 31 //up button
#define BTN2PIN 30 //down button

// LED Strip
#define LEDPIN 23

// Create Steppers
A4988 stepper1(MOTOR_STEPS, S1DIR, S1STEP, S1SLEEP, S1MS1, S1MS2, S1MS3); //z axis
A4988 stepper2(MOTOR_STEPS, S2DIR, S2STEP, S2SLEEP, S2MS1, S2MS2, S2MS3); //x axis
A4988 stepper34(MOTOR_STEPS, S34DIR, S34STEP, S34SLEEP, S34MS1, S34MS2, S34MS3); //y axis

// Create LCD
LiquidCrystal_I2C LCD(0x27,20,4);  // set the LCD address to 0x27 for a 16 chars and 2 line display

//game mode
boolean casual = true;

//z axis length - 1 rotation (200 steps) = 2 inches, 40 inches total of string, 4000 total steps, 
//worst case is 16 inches
//moves .0349 radians * .3 in radius = .01047
double zLength = 16.0;
double zChange = .00349 * .3;

void setup() { 
  // Serial Output
  Serial.begin(9600);

  // Setup LCD
  LCD.init();  //initialize the lcd
  LCD.backlight();  //open the backlight 
  LCD.setCursor(0,0); //sets LCD cursor to upper left - 0, 0
  
  // Setup Steppers
  stepper1.begin(RPM, MICROSTEPS); // RPM = 1, Microsteps = 1
  stepper2.begin(RPM, MICROSTEPS);
  stepper34.begin(RPM, MICROSTEPS);
  
  // Setup Servo
  claw.attach(clawPin);
  pinMode(buttonPin, INPUT);
  claw.write(Closed);

  // Setup Joystick
  pinMode(JSUP, INPUT_PULLUP);
  pinMode(JSDOWN, INPUT_PULLUP);
  pinMode(JSRIGHT, INPUT_PULLUP);
  pinMode(JSLEFT, INPUT_PULLUP);
  
  // Setup Buttons
  pinMode(BTN1PIN, INPUT_PULLUP); //up
  pinMode(BTN2PIN, INPUT_PULLUP); //down
  
  // Setup Limit Switches
  pinMode(LMT1PIN, INPUT_PULLUP); //x 0
  pinMode(LMT2PIN, INPUT_PULLUP); //x max
  pinMode(LMT3PIN, INPUT_PULLUP); //y 0
  pinMode(LMT4PIN, INPUT_PULLUP); //y max
  
  setupClawGame();
  
  LCDChoices();
}

void setupClawGame() {
  //Beginning Sequence:
  
    //1. Raise Claw (Z stepper)
    while (zLength > 0)
    {
      stepper1.move(STEPS);
      zLength -= zChange;
    }
    
    //2. Run X and Y axis steppers until they hit limit switches setting X and Y axis to position (0,0)
    while (!(digitalRead(LMT2PIN) == HIGH))
    {
      stepper34.enable();
      stepper34.move(STEPS);
    }
    
    while ((digitalRead(LMT1PIN) == HIGH))
    {
      stepper2.enable();
      stepper2.move(-STEPS);
    }

    
    //competitive
    if(!casual)
    {
      claw.write(Opened);
      delay(3000);
      claw.write(Closed);
    }
}

void LCDChoices() {
  //LCD
    LCD.clear();
    LCD.setCursor(0,0); //go to 1st column, 2nd row
    LCD.print("What kind of game?");
    LCD.setCursor(0,2);
    LCD.print("1. Casual");
    LCD.setCursor(0,3);
    LCD.print("2. Competitive");
    boolean cut = false;
    while (!cut)
    {
      if (digitalRead(BTN1PIN) == HIGH)
      {
        casual = true;
        LCD.clear();
        LCD.setCursor(0,0);
        LCD.print("Casual");
        LCD.setCursor(0,1);
        LCD.print("Top button:up");
        LCD.setCursor(0,2);
        LCD.print("Bottom button:down");
        LCD.setCursor(0,3);
        LCD.print("Blue button:claw");
        cut = true;
      }
      
      if (digitalRead(BTN2PIN) == HIGH)
      {
        casual = false;
        LCD.clear();
        LCD.setCursor(0,0);
        LCD.print("Competitive");
        LCD.setCursor(0,1);
        LCD.print("Blue button:Claw");
        cut = true;
      }
    }
}

void ClawUpDown() {
  if (casual)
  {
    int buttonState = digitalRead(buttonPin);
        //open/close servo:
    if (digitalRead(buttonPin) == HIGH && !bounce)
    {
      bounce = true;
      doWork = !doWork;
      if (doWork)
        claw.write(Opened);
    
      else
        claw.write(Closed); 
    }
    if (digitalRead(buttonPin) == LOW && bounce)
      bounce = false;
    
    if (digitalRead(BTN1PIN) == HIGH)
    {
      stepper1.enable();
      while (digitalRead(BTN1PIN) == HIGH && zLength > 0) {
        stepper1.move(STEPS);
        zLength -= zChange;
      }
    } 
    
    else if (digitalRead(BTN2PIN) == HIGH)
    {
      stepper1.enable();
      while (digitalRead(BTN2PIN) == HIGH) {
        stepper1.move(-STEPS);
        zLength += zChange;
      }
    }
  }
  
  else
  {
    int buttonState = digitalRead(buttonPin);
    claw.write(Closed);
    
    if (buttonState == 1)
    {      
      //down
      claw.write(Opened);
      stepper1.enable();
      while (zLength < 20)
      {
        stepper1.move(-STEPS);
        zLength += zChange;
      }
      
      //up
      delay(2000);
      claw.write(Closed);
      stepper1.enable();
      while(zLength > 0)
      {
        stepper1.move(STEPS);
        zLength -= zChange;
      }
      
      //reset game
      setupClawGame();
      LCDChoices();
    }
  }
}

void Joystick() {
  // int joyPins[] = {JSUP, JSDOWN, JSRIGHT, JSLEFT};
  // String joyLabels[] = {"U", "D", "R", "L"};
  

   if (digitalRead(JSUP) == 1 && !(digitalRead(LMT3PIN) == 1))// && !digitalRead(LMT4PIN))
  {
    //move y motor up
    stepper34.enable();
    while (digitalRead(JSUP) == 1 && !(digitalRead(LMT3PIN) == 1))
      stepper34.move(-STEPS); //5
  }

  else if (digitalRead(JSDOWN) == 1 && !(digitalRead(LMT2PIN) == 1))// && !digitalRead(LMT3PIN))
  {
    //move y motor down
    stepper34.enable();
    while (digitalRead(JSDOWN) == 1 && !(digitalRead(LMT2PIN) == 1))
      stepper34.move(STEPS); //5
  }

  if (digitalRead(JSRIGHT) == 1 && (digitalRead(LMT4PIN) == 1))// && !digitalRead(LMT2PIN))
  {
    //move x motor right
    stepper2.enable();
    while (digitalRead(JSRIGHT) == 1 && (digitalRead(LMT4PIN) == 1))
      stepper2.move(STEPS); //5
  }

  else if (digitalRead(JSLEFT) == 1 && (digitalRead(LMT1PIN) == 1))// && !digitalRead(LMT1PIN))
  {
    //move x motor left
    stepper2.enable();
    while (digitalRead(JSLEFT) == 1 && (digitalRead(LMT1PIN) == 1))
      stepper2.move(-STEPS); //5
  }
}

void loop() {
  
  //testing
    // Serial.print("Z length: ");
    // Serial.println(zLength); //testing z axis
    // Serial.println("/nButtons:");
    // Serial.println(digitalRead(BTN1PIN)); //LMT1PIN
    
    
    // LCD.clear();
    //TEST BUTTONS
    // LCD.setCursor(0,0);
    // LCD.print("UP: " );
    // LCD.print(digitalRead(BTN1PIN));
    // LCD.setCursor(0,1);
    // LCD.print("DOWN: ");
    // LCD.print(digitalRead(BTN2PIN));
    // LCD.setCursor(0,2);
    // LCD.print("CLAW: ");
    // LCD.print(digitalRead(buttonPin));
 
    //  TEST JOYSTICK
    // LCD.setCursor(0,1);
    // LCD.print("Up: " );
    // LCD.println(digitalRead(JSUP));
    // LCD.setCursor(0,2);
    // LCD.print("Down: " );
    // LCD.println(digitalRead(JSDOWN));
    // LCD.setCursor(0,3);
    // LCD.print("Left: " );
    // LCD.println(digitalRead(JSLEFT));
    // LCD.setCursor(0,4);
    // LCD.print("Right: " );
    // LCD.println(digitalRead(JSRIGHT));
 
    // TEST LIMIT SWITCHES
    // LCD.setCursor(0,0);
    // LCD.print("LIMIT 1: " );
    // LCD.print(digitalRead(LMT1PIN));
    // LCD.setCursor(0,1);
    // LCD.print("LIMIT 2: " );
    // LCD.print(digitalRead(LMT2PIN));
    // LCD.setCursor(0,2);
    // LCD.print("LIMIT 3: " );
    // LCD.print(digitalRead(LMT3PIN));
    // LCD.setCursor(0,3);
    // LCD.print("LIMIT 4: " );
    // LCD.print(digitalRead(LMT4PIN));
    
    // LCD.clear();
    // LCD.setCursor(0,1);
    // LCD.print(digitalRead(BTN1PIN));
    // LCD.setCursor(1,1);
    // LCD.print("Z length: ");
    // LCD.print(zLength);
  
  //playing
    
    //Joystick
    Joystick();
    
    //claw
    ClawUpDown();
    delay(70);
}